## src/modules/course/hello_world/Kconfig
```kconfig
menuconfig MODULES_COURSE_HELLO_WORLD
	depends on MODULES_COURSE
	bool "hello"
	default y
	---help-- -
		Enable the simple hello world module
```

## src/modules/course/task_module/Kconfig
```kconfig
menuconfig MODULES_COURSE_TASK_MODULE
	depends on MODULES_COURSE
	bool "task_module"
	default y
	---help---
		Enable the Ascend PX4 course module
```

## src/modules/px4_course/Kconfig
```kconfig
menuconfig MODULES_PX4_COURSE
	bool "px4_course"
	default n
	---help---
		Enable the Ascend PX4 course module
```
